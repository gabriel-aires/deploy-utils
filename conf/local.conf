## conf/local.conf
```bitbake
# Definir abaixo as variáveis do ambiente JBOSS:

CAMINHO_INSTANCIAS_JBOSS=""																# Ex: /opt/jboss/server (o caminho não deve terminar em "/" )
VERSAO_JBOSS=""																			# 4, 5
ACESSO=""																				# INTRANET, INTERNET, iNTRANET_INTERNET, INTERNET_1, INTRANET_2, etc
AMBIENTE=""																				# DESENVOLVIMENTO, HOMOLOGAÇÃO, TESTES
```
